## conf/machine/edge-ai-nano-8g.conf
```bitbake
#@TYPE: Machine
#@NAME: CompuLab Edge-AI with Nvidia Jetson Orin NANO 8GB (P3767-0003)
#@DESCRIPTION: Nvidia Jetson Orin NANO module in CompuLab Edge-AI board

require conf/machine/p3768-0000-p3767-0003.conf
require conf/machine/include/devkit-wifi.inc
require edge-ai.inc
```

## conf/machine/edge-ai-nano-evk.conf
```bitbake
#@TYPE: Machine
#@NAME: CompuLab Edge-AI with Nvidia Jetson Orin NANO 8GB (P3767-0005) evk module
#@DESCRIPTION: Nvidia Jetson Orin NANO module in CompuLab Edge-AI board

require conf/machine/p3768-0000-p3767-0003.conf
require conf/machine/include/devkit-wifi.inc
require edge-ai.inc
TEGRA_BOARDSKU = "0005"
```

## conf/machine/edge-ai-nx-16g.conf
```bitbake
#@TYPE: Machine
#@NAME: CompuLab Edge-AI with Nvidia Jetson Orin NX 16GB (P3767-0000)
#@DESCRIPTION: Nvidia Jetson Orin NX module in CompuLab Edge-AI board

require conf/machine/p3768-0000-p3767-0000.conf
require edge-ai.inc
```

## conf/machine/edge-ai-nx-8g.conf
```bitbake
#@TYPE: Machine
#@NAME: CompuLab Edge-AI with Nvidia Jetson Orin NX 8GB (P3767-0001)
#@DESCRIPTION: Nvidia Jetson Orin NX module in CompuLab Edge-AI board

require conf/machine/p3768-0000-p3767-0001.conf
require edge-ai.inc
```
