// SPDX-License-Identifier: GPL-2.0-only
// SPDX-FileCopyrightText: Copyright (c) 2026 CompuLab Ltd.

/dts-v1/;
/plugin/;

#include <dt-bindings/gpio/gpio.h>
#include <dt-bindings/gpio/tegra234-gpio.h>
#include <dt-bindings/media/video-interfaces.h>

/* One four-camera profile: one IMX676 on each MAX96724 GMSL input. */
/ {
	overlay-name = "CompuLab EDGEDES ADI v18 FRAMOS IMX676 four-port";
	compatible = "compulab,edgeai-orn", "nvidia,tegra234";

	#include "edgedes-adi-v18-framos-imx676-4port-deserializer.dtsi"
	#include "edgedes-adi-v18-framos-imx676-port0.dtsi"
	#include "edgedes-adi-v18-framos-imx676-port1.dtsi"
	#include "edgedes-adi-v18-framos-imx676-port2.dtsi"
	#include "edgedes-adi-v18-framos-imx676-port3.dtsi"
	#include "edgedes-adi-v18-framos-imx676-4port-nvcsi.dtsi"
	#include "edgedes-adi-v18-framos-imx676-4port-vi.dtsi"
	#include "edgedes-adi-v18-framos-imx676-4port-camera-platform.dtsi"
};
