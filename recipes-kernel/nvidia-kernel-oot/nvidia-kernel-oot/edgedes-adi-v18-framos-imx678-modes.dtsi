// SPDX-License-Identifier: GPL-2.0-only
// SPDX-FileCopyrightText: Copyright (c) 2026 CompuLab Ltd.

/*
 * Include inside the sensor node with EDGEDES_IMX678_VC_ID set to the
 * downstream Tegra virtual-channel string. The native sensor always emits VC0.
 * Keep the qualified mode 0. Additional modes require matching NITO mode
 * knobsets and separate DUT qualification; the recipe leaves them off by default.
 */
#ifndef EDGEDES_IMX678_VC_ID
#error "Define EDGEDES_IMX678_VC_ID before including the IMX678 modes"
#endif

mode0 {
	vc_id = EDGEDES_IMX678_VC_ID;
#include "edgedes-adi-v18-framos-imx678-mode.dtsi"
};

#ifdef EDGE_AI_IMX678_EXTENDED_MODES
mode1 {
	vc_id = EDGEDES_IMX678_VC_ID;
#include "edgedes-adi-v18-framos-imx678-mode-common.dtsi"
	active_w = "3856";
	active_h = "2180";
	min_framerate = "30000000";
	max_framerate = "30000000";
	default_framerate = "30000000";
	max_exp_time = "33212";
};

mode2 {
	vc_id = EDGEDES_IMX678_VC_ID;
#include "edgedes-adi-v18-framos-imx678-mode-common.dtsi"
	active_w = "2608";
	active_h = "1964";
	min_framerate = "30000000";
	max_framerate = "30000000";
	default_framerate = "30000000";
	max_exp_time = "33212";
};

mode3 {
	vc_id = EDGEDES_IMX678_VC_ID;
#include "edgedes-adi-v18-framos-imx678-mode-common.dtsi"
	active_w = "1920";
	active_h = "1080";
	min_framerate = "30000000";
	max_framerate = "30000000";
	default_framerate = "30000000";
	max_exp_time = "33212";
};
#endif
