// SPDX-License-Identifier: GPL-2.0-only
// SPDX-FileCopyrightText: Copyright (c) 2026 CompuLab Ltd.

/dts-v1/;
/plugin/;

#include <dt-bindings/gpio/gpio.h>
#include <dt-bindings/gpio/tegra234-gpio.h>
#include <dt-bindings/media/video-interfaces.h>

/*
 * Apply after edgedes-adi-v18-transport-4port.dtbo.
 * Select exactly one sensor-model leaf for each physical GMSL port.
 * Other port leaves may be added in any order after the common transport.
 */
/ {
	overlay-name = "CompuLab EDGEDES ADI v18 IMX678 camera port 2";
	compatible = "compulab,edgeai-orn", "nvidia,tegra234";

	#include "edgedes-adi-v18-framos-imx678-port2.dtsi"

	/* Complete both directions without common-to-future-leaf fixups. */
	fragment@8 {
		target = <&edgedes_adi_framos_gmsl2_in>;
		__overlay__ {
			remote-endpoint = <&edgedes_adi_framos_ser2_out>;
		};
	};

	fragment@9 {
		target = <&edgedes_adi_framos_module2>;
		__overlay__ {
			status = "okay";
			badge = "imx678_port2_framos";
			position = "front";
			orientation = "1";
			drivernode0 {
				pcl_id = "v4l2_sensor";
				sysfs-device-tree = "/sys/firmware/devicetree/base/bus@0/i2c@3180000/deserializer@27/i2c-atr/i2c@2/serializer@40/i2c-atr/i2c@0/imx678@1a";
			};
		};
	};
};
